## sdkconfig.defaults
```kconfig
# Meantendo SDK Configuration Defaults
# ESP-IDF Configuration for Gaming Console

# CPU Frequency
CONFIG_ESP32_DEFAULT_CPU_FREQ_240=y

# PSRAM Configuration (Required for DOOM)
CONFIG_SPIRAM=y
CONFIG_SPIRAM_SUPPORT=y
CONFIG_SPIRAM_USE_MALLOC=y
CONFIG_SPIRAM_MALLOC_ALWAYSINTERNAL=16384
CONFIG_SPIRAM_TRY_ALLOCATE_WIFI_LWIP=y
CONFIG_SPIRAM_BOOT_INIT=y
CONFIG_SPIRAM_SPEED_80M=y
CONFIG_SPIRAM_MODE_QUAD=y

# Memory Configuration
CONFIG_ESP32_IRAM_AS_8BIT_ACCESSIBLE_MEMORY=y
CONFIG_HEAP_POISONING_DISABLED=y

# Flash Configuration
CONFIG_ESPTOOLPY_FLASHSIZE_4MB=y
CONFIG_PARTITION_TABLE_CUSTOM=y
CONFIG_PARTITION_TABLE_CUSTOM_FILENAME="partitions.csv"

# FreeRTOS Configuration
CONFIG_FREERTOS_HZ=1000
CONFIG_FREERTOS_TIMER_TASK_PRIORITY=2
CONFIG_FREERTOS_TIMER_TASK_STACK_DEPTH=3072

# Log Level
CONFIG_LOG_DEFAULT_LEVEL_INFO=y

# SPI Configuration
CONFIG_SPI_MASTER_ISR_IN_IRAM=y

# GPIO Configuration
CONFIG_GPIO_ESP32_SUPPORT_SWITCH_SLP_PULL=y

# WiFi Configuration (for OTA)
CONFIG_ESP_WIFI_STATIC_RX_BUFFER_NUM=10
CONFIG_ESP_WIFI_DYNAMIC_RX_BUFFER_NUM=32
CONFIG_ESP_WIFI_TX_BUFFER_TYPE=1
CONFIG_ESP_WIFI_DYNAMIC_TX_BUFFER_NUM=32

# HTTP/HTTPS Configuration
CONFIG_ESP_HTTP_CLIENT_ENABLE_HTTPS=y
CONFIG_ESP_TLS_USING_MBEDTLS=y
```
